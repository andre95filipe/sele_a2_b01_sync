#include <pcd8544.h>
#include <pcd8544_ascii.h>
#include <spi.h>

const uint8_t lindo_Width    = 84;
const uint8_t lindo_Height   = 48;
const uint8_t lindo_Bitmap[] = { 
  0x00, 0x00, 0x00, 0x00, 0x00, 0x00, 0x00, 0x00, 0x00, 0x00, 0x00, 0x00,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 0xff, 
  0x00, 0x00, 0x00, 0x00, 0x00, 0x00, 0x00, 0x00, 0x00, 0xc0, 0x00, 0x00,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 0xff, 
  0x00, 0x00, 0x00, 0x00, 0x00, 0x00, 0x00, 0x00, 0x00, 0x80, 0xf8, 0xfc,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 0xff, 
  0x00, 0x00, 0x00, 0x00, 0x00, 0x00, 0x00, 0x00, 0x00, 0x00, 0x03, 0x1f,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 0xff, 
  0x00, 0x00, 0x00, 0x00, 0x00, 0x00, 0x00, 0x00, 0x00, 0x00, 0x00, 0x00,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 0xff, 
  0x00, 0x00, 0x00, 0x00, 0x00, 0x00, 0x00, 0x00, 0x00, 0x00, 0x00, 0x00,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 0xff
};

void PCD8544::begin() {
    SPI.begin(MSB, MASTER, MODE0, FOSC_16);
    // SET RST and DC as outputs
    DDRB |= _BV(DC) | _BV(RST); 

    // Set RST = 1 and DC = 0
    PORTB |= _BV(RST);
    PORTB &= ~_BV(DC);

    // Reset LCD
    PORTB &= _BV(RST);
    delay(100);
    PORTB |= _BV(RST);

    this->write(0x21, COMMAND); // Use Extended instruction set
    this->write(0x13, COMMAND); // Bias system (1:48)
    this->write(0xc2, COMMAND); // Vop 3.06 + 66 * 0.06 = 7V
    this->write(0x20, COMMAND); // Use basic instruction set

    this->write(0x09, COMMAND); // All display segments on

    this->clear();              // Clear screen

    this->write(0x08, COMMAND); // Set display blank
    this->write(0x0c, COMMAND); // Set normal mode

    delay(100);

    this->setCursor(0, 0);
}

void PCD8544::setCursor(uint8_t x, uint8_t y) {
    this->write(0x80 | x, COMMAND);
    this->write(0x40 | y, COMMAND);
}

void PCD8544::clear() {
    this->setCursor(0, 0);
    for(uint16_t i = 0; i < X * Y; i++)
        this->write(0x00, DATA);
    this->setCursor(0, 0);
}

void PCD8544::drawBitmap() {
    this->setCursor(0, 0);
    for(uint16_t i = 0; i < X * Y; i++){
        this->write(lindo_Bitmap[i], DATA);
    }
        
    this->setCursor(0, 0);
}

void PCD8544::write(uint8_t data, uint8_t dc) {
    PORTB = dc ? PORTB | _BV(DC) : PORTB & ~_BV(DC);
    SPI.transmit(data);
}

void PCD8544::print(const char c) {
    for (uint8_t i = 0; i < 5; i++)
        this->write(ASCII[c - 0x20][i], DATA);
    this->write(0x00, DATA);
}

void PCD8544::print(const char *c) {
    while(*c)
        this->print(*c++);
}
